## apps/sbusconv/main/Kconfig.projbuild
```kconfig
menu "SBUS converter Configuration"

choice PHY_MODEL
    prompt "Ethernet PHY"
    default CONFIG_PHY_LAN8720
    help
        Select the PHY driver to use for the example.

config PHY_TLK110
    bool "TI TLK110 PHY"
    help
        Select this to use the TI TLK110 PHY

config PHY_LAN8720
    bool "Microchip LAN8720 PHY"
    help
        Select this to use the Microchip LAN8720 PHY

endchoice

config PHY_ADDRESS
    int "PHY Address (0-31)"
    default 31
    range 0 31
    help
        Select the PHY Address (0-31) for the hardware configuration and PHY model.

config PHY_USE_POWER_PIN
    bool "Use PHY Power (enable/disable) pin"
    default y
    help
        Use a GPIO "power pin" to power the PHY on/off during operation.
        Consult the example README for more details

config PHY_POWER_PIN
    int "PHY Power GPIO"
    default 17
    depends on PHY_USE_POWER_PIN
    help
        GPIO number to use for powering on/off the PHY.

config PHY_SMI_MDC_PIN
    int "SMI MDC Pin"
    default 23
    help
        GPIO number to use for SMI clock output MDC to PHY.

config PHY_SMI_MDIO_PIN
    int "SMI MDIO Pin"
    default 18
    help
       GPIO number to use for SMI data pin MDIO to/from PHY.

config ENABLE_WIFI_AP
    bool "Enable WiFi AP"
    default n
    help
        Enable WiFi AP function

config ADAPTOR_ADDRESS
    string "IPv4 address of this adaptor as a Wi-Fi AP"
    depends on ENABLE_WIFI_AP
    default "192.168.11.1"
    help
        This adaptor's Wi-Fi address

config SSID
    string "WIFI access point name (SSID)"
    depends on ENABLE_WIFI_AP
    default "ssidofthisAP"
    help
        Enter the name of the WIFI access point

config SSID_PASSWORD
    string "WIFI password"
    depends on ENABLE_WIFI_AP
    default "w1f1p@$$wOrd"
    help
        Enter ssid password

config UDP_SERVER_ADDRESS
    string "IPv4 address of UDP server"
    default "10.253.253.25"
    help
        IP address of the UDP server connected with ether

config UDP_PORT
    int "UDP port"
    default 5990
    help
        UDP port used for propo packet

config COPY_CH6_CH7
    bool "Copy CH6 to CH7"
    default n
    help
        Copy CH6 to CH7

endmenu
```
